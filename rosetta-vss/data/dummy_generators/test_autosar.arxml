AUTOSAR XML (schema 4.0)
package /VehicleInterfaces
  sender receiver interface PowertrainData_I
    data EngineSpeed_rpm  # Current rotation speed of the internal combustion engine.
    data TransGear_Current
  sender receiver interface DoorStatus_I
    data DrvrDoor_Open  # Boolean status of driver door.
